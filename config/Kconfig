## config/Kconfig
```kconfig
# Copyright (c) 2024 M0110 ZMK Driver
# SPDX-License-Identifier: MIT

rsource "drivers/Kconfig"
rsource "src/Kconfig"
rsource "clipboard/Kconfig"
```

## config/boards/framework/framework_cb/Kconfig.framework_cb
```kconfig
# Copyright (c) 2026 The ZMK Contributors
# SPDX-License-Identifier: MIT

config BOARD_FRAMEWORK_CB
	select SOC_NRF54LM20A_CPUAPP if BOARD_FRAMEWORK_CB_NRF54LM20A_CPUAPP
```

## config/boards/framework/framework_cb/board.yml
```yaml
board:
  name: framework_cb
  full_name: Framework Wireless Keyboard Control Board
  vendor: framework
  socs:
    - name: nrf54lm20a
```

## config/boards/framework/framework_cb/framework_cb_nrf54lm20a_cpuapp_defconfig
```kconfig
# Copyright (c) 2026 The ZMK Contributors
# SPDX-License-Identifier: MIT

CONFIG_GPIO=y
CONFIG_ARM_MPU=y
CONFIG_NULL_POINTER_EXCEPTION_DETECTION_NONE=y
CONFIG_CACHE_MANAGEMENT=y
CONFIG_EXTERNAL_CACHE=y
CONFIG_NRF_GRTC_START_SYSCOUNTER=y
CONFIG_FLASH=y
CONFIG_FLASH_MAP=y
CONFIG_ZMS=y
CONFIG_SETTINGS_ZMS=y
CONFIG_MPU_ALLOW_FLASH_WRITE=y
```

## config/boards/shields/m0110/Kconfig.defconfig
```kconfig
# Copyright (c) 2024 M0110 ZMK Driver
# SPDX-License-Identifier: MIT

if SHIELD_M0110

config ZMK_KEYBOARD_NAME
    default "M0110 Converter"

config INPUT
    default y

config INPUT_M0110
    default y

endif # SHIELD_M0110
```

## config/clipboard/Kconfig
```kconfig
# Copyright (c) 2026 M0110 ZMK Driver
# SPDX-License-Identifier: MIT

config ZMK_CLIPBOARD
    bool "Carry what was copied between paired computers"
    depends on ZMK_BLE
    help
      Holds the last text copied on one computer and hands it to the next
      one the keyboard is switched to: to that computer's clipboard if it
      runs the helper, and as typed keystrokes if it does not. Images and
      long text go between two computers that both run the helper.

      The computer that is copied from has to run the helper. The clip is
      kept in RAM only.

if ZMK_CLIPBOARD

config ZMK_CLIPBOARD_MAX_LEN
    int "Longest text clip to hold, in bytes"
    default 16384
    range 64 16384
    help
      Text longer than this is refused, and the keyboard then carries
      nothing rather than a truncated clip. The helpers pass longer text
      between themselves instead, as they do images.

config ZMK_CLIPBOARD_OPAQUE_MAX_LEN
    int "Longest message between helpers to hold, in bytes"
    default 61440
    range 0 65535
    help
      What cannot be typed, an image or a long text, goes from helper to
      helper over the network, and the keyboard only carries the short
      message that says where to fetch it. When the two computers cannot
      reach each other the content itself comes through the keyboard, cut
      down to fit in this many bytes. 0 turns all of that off.

      The larger of this and the text limit is reserved in RAM.

config ZMK_CLIPBOARD_TTL_SEC
    int "Seconds a clip is held before it is wiped"
    default 120
    range 5 3600
    help
      A clip that outlives its usefulness is a liability twice over: it is
      someone's clipboard sitting in a keyboard, and it turns a paste on a
      computer without the helper into typing long after the copy that
      made sense of it.

config ZMK_CLIPBOARD_TYPE_DELAY_MS
    int "Milliseconds between HID reports while typing a clip"
    default 12
    range 2 200
    help
      Each character is two reports, a press and a release. Too short and
      some hosts and remote desktops drop keys.

config ZMK_CLIPBOARD_ACK_WAIT_MS
    int "Milliseconds a paste waits for the helper before typing instead"
    default 700
    range 50 5000

endif # ZMK_CLIPBOARD
```

## config/drivers/Kconfig
```kconfig
# Copyright (c) 2024 M0110 ZMK Driver
# SPDX-License-Identifier: MIT

rsource "input/Kconfig"
```

## config/drivers/input/Kconfig
```kconfig
# Copyright (c) 2024 M0110 ZMK Driver
# SPDX-License-Identifier: MIT

if INPUT

config INPUT_M0110
	bool "Apple M0110/M0110A keyboard scanner driver"
	default n
	depends on GPIO
	help
	  Enable driver for Apple M0110, M0110A, and M0120 keyboards.
	  These vintage Apple keyboards use a synchronous serial protocol
	  with clock and data lines.

	  Reports through the input subsystem: the column on INPUT_ABS_X, the
	  row on INPUT_ABS_Y and the pressed state on INPUT_BTN_TOUCH, which is
	  what ZMK's `zmk,matrix-input` chosen expects.

if INPUT_M0110

config INPUT_M0110_TRACE
	bool "Trace every wire byte and key event"
	default n
	help
	  Log each raw byte received from the keyboard and each key event handed
	  to ZMK, both with an uptime stamp.  This is how you tell a keyboard that
	  reports two transitions out of order from a driver that reorders them:
	  the wire trace shows what actually arrived, in the order it arrived.

	  Costs flash and adds work to the receive path, so it is off by default.

config INPUT_M0110_POLL_PERIOD_MS
	int "Polling period in milliseconds"
	default 5
	help
	  How often to poll the keyboard for key events.

endif # INPUT_M0110

endif # INPUT
```

## config/drivers/kscan/Kconfig
```kconfig
# Copyright (c) 2024 M0110 ZMK Driver
# SPDX-License-Identifier: MIT

config KSCAN_M0110
	bool "Apple M0110/M0110A keyboard scanner driver"
	default n
	depends on GPIO
	help
	  Enable driver for Apple M0110, M0110A, and M0120 keyboards.
	  These vintage Apple keyboards use a synchronous serial protocol
	  with clock and data lines.
```

## config/drivers/sensor/Kconfig
```kconfig
# Copyright (c) 2026 M0110 ZMK Driver
# SPDX-License-Identifier: MIT

DT_COMPAT_ZMK_BATTERY_VDDH_OCV := zmk,battery-vddh-ocv

config ZMK_BATTERY_VDDH_OCV
	bool
	default $(dt_compat_enabled,$(DT_COMPAT_ZMK_BATTERY_VDDH_OCV))
	select ADC
	depends on SENSOR
	help
	  nice!nano v2 VDDH battery sensor that corrects for the charger's
	  output offset and uses an OCV table for state of charge.
```

## config/dts/bindings/kscan/zmk,kscan-m0110.yaml
```yaml
# Copyright (c) 2024 M0110 ZMK Driver
# SPDX-License-Identifier: MIT

description: |
  Apple M0110/M0110A/M0120 keyboard scanner driver.

  These vintage Apple Macintosh keyboards use a 2-wire synchronous serial
  protocol with clock and data lines. The keyboard drives the clock, and
  data is bidirectional.

  Example configuration:

    kscan0: kscan_m0110 {
        compatible = "zmk,kscan-m0110";
        data-gpios = <&gpio0 17 (GPIO_ACTIVE_HIGH | GPIO_PULL_UP)>;
        clock-gpios = <&gpio0 20 (GPIO_ACTIVE_HIGH | GPIO_PULL_UP)>;
        en-gpios = <&gpio0 6 GPIO_ACTIVE_HIGH>;
        idle-timeout-ms = <300000>;
        peek-interval-ms = <5000>;
        rows = <14>;
        columns = <8>;
    };

compatible: "zmk,kscan-m0110"

include: kscan.yaml

properties:
  data-gpios:
    type: phandle-array
    required: true
    description: GPIO connected to the M0110 data line (directly to keyboard)

  clock-gpios:
    type: phandle-array
    required: true
    description: GPIO connected to the M0110 clock line (directly to keyboard)

  poll-period-ms:
    type: int
    default: 5
    description: |
      Deprecated — ignored by the interrupt-driven driver.
      The driver now uses INQUIRY with a clock-line interrupt instead of
      polling, so the CPU sleeps between key events.

  en-gpios:
    type: phandle-array
    description: |
      Optional GPIO connected to the 5V boost converter's EN (enable) pin.
      When specified, the driver disables the boost converter after the idle
      timeout to save power, and periodically re-enables it to check for
      keyboard activity.  The TPS61023 draws only 0.1 µA when disabled.

  idle-timeout-ms:
    type: int
    default: 300000
    description: |
      Milliseconds of inactivity before the driver disables the 5V boost
      converter (requires en-gpios).  Default is 5 minutes.

  peek-interval-ms:
    type: int
    default: 5000
    description: |
      How often (in milliseconds) to briefly re-enable the 5V boost and
      check for keyboard activity while in power-save mode.  The keyboard
      needs ~1 s to boot each time, so very short intervals reduce savings.
      Default is 5 seconds.

  rows:
    type: int
    required: true
    description: |
      Number of rows in the virtual key matrix.
      For M0110A this should be 14 (scancodes 0x00-0x6F mapped as row = scancode >> 3).

  columns:
    type: int
    required: true
    description: |
      Number of columns in the virtual key matrix.
      For M0110A this should be 8 (scancodes mapped as col = scancode & 0x07).
```

## config/dts/bindings/sensor/zmk,battery-vddh-ocv.yaml
```yaml
# Copyright (c) 2026 M0110 ZMK Driver
# SPDX-License-Identifier: MIT

description: |
  nice!nano v2 battery sensor.  Reads VDDH like zmk,battery-nrf-vddh, but
  subtracts the bq24072 charger's OUT offset while USB is plugged in and maps
  the cell voltage to a state of charge through an OCV table.

  Example configuration:

    battery: battery {
        compatible = "zmk,battery-vddh-ocv";
        ocv-capacity-table-0 = <3270000 3690000 3730000 3770000 3800000 3840000
                                3870000 3950000 4020000 4110000 4200000>;
        charge-full-design-microamp-hours = <10000000>;
        constant-charge-current-max-microamp = <1100000>;
    };

compatible: "zmk,battery-vddh-ocv"

include:
  - name: battery.yaml
    property-allowlist:
      - ocv-capacity-table-0
      - charge-full-design-microamp-hours
      - constant-charge-current-max-microamp

properties:
  ocv-capacity-table-0:
    required: true

  charge-full-design-microamp-hours:
    required: true

  constant-charge-current-max-microamp:
    required: true
    description: |
      Most charge current all chargers on the cell can deliver together.  The
      reported state of charge never rises faster than this current fills the
      design capacity.

  charger-out-offset-microvolt:
    type: int
    default: 225000
    description: |
      How far VDDH sits above the resting cell voltage while USB is plugged
      in, used until the driver has measured it across a plug or unplug.  The
      bq24072's datasheet gives 150 to 270 mV, typically 225 mV; any other
      charger running from the same cable adds its charge current times the
      cell and wiring resistance.
```

## config/src/Kconfig
```kconfig
# Copyright (c) 2026 M0110 ZMK Driver
# SPDX-License-Identifier: MIT

config ZMK_BATTERY_REPORT_WHILE_IDLE
	bool "Keep the BLE battery level current while idle"
	default y
	depends on ZMK_BATTERY_REPORTING_FETCH_MODE_STATE_OF_CHARGE && BT_BAS
	help
	  ZMK stops sampling the battery while the keyboard is idle, so hosts
	  keep reading the level from the last time anyone typed.  This keeps
	  refreshing the BLE Battery Service on ZMK's report interval until
	  the next key.

DT_CHOSEN_M0110_STUDIO_RPC_UART := zmk,studio-rpc-uart

config ZMK_STUDIO_TRANSPORT_UART_NONBLOCKING
	bool "Studio serial transport whose TX callback cannot stall the USB work queue"
	default y
	depends on ZMK_STUDIO_RPC && !ZMK_STUDIO_TRANSPORT_UART && UART_INTERRUPT_DRIVEN
	depends on $(dt_chosen_enabled,$(DT_CHOSEN_M0110_STUDIO_RPC_UART))
	help
	  Replaces ZMK's own serial transport, which must be turned off with
	  CONFIG_ZMK_STUDIO_TRANSPORT_UART=n.  ZMK's version spins on the USB
	  work queue whenever a reply outgrows the CDC ring buffer, and the
	  keyboard locks up until it loses power.

config ZMK_PROFILE_REPORT
	bool "Tell connected computers which Bluetooth profile is active"
	default y
	depends on ZMK_BLE
	help
	  Switching profile leaves every Bluetooth link up, so a computer the
	  keyboard has moved away from cannot tell: it stays connected and
	  gets no keys.  This adds a GATT service that notifies each connected
	  computer of the active profile and of its own, so a helper such as
	  the M0110 HUD can say where the keyboard went.
```
